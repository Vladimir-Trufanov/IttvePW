/** Arduino UNO, SIM900 ****************************************** SIM900.h ***
 * 
 * Обеспечить прием данных с SIM900
 * 
 * v3.0.4, 22.05.2026                                 Автор:      Труфанов В.Е.
 * Copyright © 2025 tve                               Дата создания: 16.10.2025
**/

#ifndef SIM900_h
#define SIM900_h
#pragma once 
SoftwareSerial SIM900(7,8);  // синий на 7 - будет RX; зеленый на 8 - будет TX
#include <avr/wdt.h>
#include <Regexp.h>
MatchState ms;               // объект соответствия выборке
#include "s32nRF24L01.h"    
bool isSIM900=false;         // false - "Не работает SIM900"

// Размещаем список команд в программной памяти
_DS(AT_AT,"AT") 
_DS(AT_CSQ,"AT+CSQ")         // проверить уровень сигнала
_DS(AT_CBC,"AT+CBC")         // получить состояние батареи

// ****************************************************************************
// *                 Сформировать сообщения по ошибке AT-команды              *
// ****************************************************************************
void ATerrorMess(char* ATcommand, uint8_t answer) 
{
  //Serial.print("answer="); Serial.println(answer); 
  // Выводим текст AT команды
  // if (answer==0) saymess(ATcommand);
  // Выводим сообщение об ошибке
  if (answer==1) Serial.println(F("Ответ SIM900 превышает 34 символа")); 
  else if (answer==2) Serial.println(F("За время тайм-аута не начат приём")); 
  else if (answer==3) Serial.println(F("Oтвет на команду не подтвержден" )); 
  else if (answer==4) Serial.println(F("За время тайм-аута не завершён ответ")); 
} 

// ****************************************************************************
// *               Отправить AT-команду на SIM900 и выбрать ответ             *
// ****************************************************************************
/*
Функция отправляет AT-команду в SIM900 и выбирает ответ за заданное время тайм-аута.
Для отправки команда должна быть размещена в буфере response не более 33 символов с завершающим нулём
Возвращается ответ answer: 
  0 - "передана команда SIM900, получен подтверждающий ответ";
  1 - "ответ SIM900 превышает 33 символов";
  2 - "за время тайм-аута не начат приём ответа";
  3 - "ответ на команду не подтвержден"
  4 - "за время тайм-аута не завершён ответ"
*/
uint8_t AT_(unsigned int timeout)
{
  // Резервируем переменную результата функции
  static uint8_t answer;                  
  // Инициируем переменные
  uint8_t i;                   // позиция в заполняемом буфере ответа GPRS(SIM900)
  answer=2;                    // "за время тайм-аута не начат приём ответа"
  unsigned long previous;      // время начала приема ответа от GPRS
  delay(100);                  // сделали начальную задержку перед подачей команды
  previous = millis();         // зафиксировали начальное время для отсчета таймаута
  // Очищаем возможно оставшийся прежний ответ от GPRS
  while (SIM900.available()>0) SIM900.read(); 
  
  // 1 шаг: Отправляем AT-команду   
  SIM900.println(response);  
  // 2 шаг: Чистим буфер для приема ответа
  memset(response,'\0',34);   // очистили буфер 
  
  // Циклимся, пока не выберем весь ответ за время тайм-аута
  i = 0;  // установили начальную позицию заполнения буфера
  do
  {
    // Если во входном буфере UART есть данные, считывает их 
    if (SIM900.available() != 0)
    {    
      response[i] = SIM900.read();
      i++;
      // Проверяем, не вышли ли за границу буфера
      if (i>33) {answer=1; break; }
    }
  }
  while((answer == 2) && ((millis() - previous) < timeout));
  // При необходимости трассируем ответ на AT-команду
  //Serial.print(F("**")); Serial.print(response); Serial.println(F("**"));
  // Если вышли ли за границу буфера, то возвращаем ошибку
  // "ответ SIM900 превышает 34 символа"  
  if (answer==1) goto by; 
  // Если остались в начальной позиции, то возвращаем ошибку
  // "за время тайм-аута не начат приём ответа"  
  else if (i==0) goto by;  
  // Если еще есть символы в буфере SIM900, то возвращаем ошибку
  // "за время тайм-аута не завершён ответ"
  else if (SIM900.available()!=0) {answer=4; goto by;} 
  // Проверяем, есть ли желаемый ответ в ответе модуля
  if (strstr(response,"OK") != NULL)    
  /* 
    Функция strstr в C++ используется для поиска первого вхождения подстроки в строке. 
    Она определена в стандартной библиотеке C, поэтому доступна и в C++.
    Параметры: response — строка, в которой выполняется поиск; expected_answer — подстрока для поиска в строке response.
    Возвращаемое значение: указатель на первое вхождение подстроки в строке; нулевой указатель (nullptr), если подстрока не найдена.
    Важно: функция чувствительна к регистру — например, поиск по «hello» не соответствует «Hello». 
    Синтаксис: char* strstr(const char* str1, const char* str2).
    Чтобы использовать strstr, в начале кода нужно включить заголовочный файл <cstring> или <string.h> — 
    это гарантирует, что компилятор распознаёт функцию.
  */ 
  {
    // "передана команда SIM900, получен подтверждающий ответ"
    answer = 0;
  }
  else 
  {
    // "ответ SIM900 на команду не подтвержден"
    answer = 3;
  }
  // Завершаем работу функции и возвращаем ответ
  by:
  ATerrorMess(response,answer);
  return answer;
}
// ****************************************************************************
// *     Загрузить AT-команду в буфер из программной памяти и отправить её    *
// *           (timeout=100, уже не хватает на команду AT, 22.05.2026)        *
// ****************************************************************************
uint8_t AT_com(const char ATcommand[],unsigned int timeout=300)
{
  // При отправке AT-команды используется один и тот же буфер для отправки команды и 
  // приёма ответа, поэтому буфер готовится (чистится) дважды
  memset(response,'\0',34);      // очистили буфер 
  strcpy_P(response,ATcommand);   // перекинули в буфер команду из программной памяти    
  return AT_(timeout);  
}
// ****************************************************************************
// *  Включить/выключить (программный триггер) SIM900 через вывод D9 Arduino  *
// *     (В качестве синхронизации включения/выключения требуется импульс     *
// *    длительностью > 1 сек,  а для стабилизации синхронизации требуется    *
// *                          задержка > 3,2 сек)                             *
// ****************************************************************************
/**
 * Включение/выключение чипа SIM900.
 * Даже при включении питания платы SIM900 необходимо включить чип SIM900, чтобы он заработал.
 * Согласно техническому описанию, для включения/выключения питания микросхемы необходимо 
 * нажимать контакт PWRKEY в течение как минимум 1 секунды. Это можно сделать двумя способами:
 * - Hardware Trigger. Плата оснащена прямоугольным тактильным переключателем, 
 * расположенным рядом со светодиодным индикатором PWR. Для включения/выключения экрана 
 * необходимо нажимать на этот переключатель в течение примерно 2 секунд.
 * - Software trigger. Вместо того чтобы каждый раз нажимать клавишу PWR вручную, 
 * вы можете программно включать/выключать SIM900. 
 * 
 * Для этого, сначала вам нужно припаять перемычку SMD между контактами R13 на 
 * плате. Далее вам нужно подключить вывод D9 платы к выводу D9 на Arduino.
**/
void SIM900powerUpOrDown()
{
  wdt_reset();
  pinMode(9, OUTPUT);
  digitalWrite(9,LOW);
  delay(1000);
  digitalWrite(9,HIGH);
  delay(2000);
  digitalWrite(9,LOW);
  delay(3000);
  wdt_reset();
}

// ****************************************************************************
// *                Выбрать в буфере подстроку по запросу regexp              *
// ****************************************************************************
int getIntByMatch(char buf[],char mch[]) 
{
  // Заводим целое число для возврата
  int i=0;
  // Чистим буфер числа
  memset(chardec,'\0',8); 
  // Выполняем поиск
  // char result = ms.Match ("f.x");
  // char result = ms.Match ("%s%s(%a+)( )");
  // char result = ms.Match ("%s%s(%a+)");
  // char result = ms.Match("%d%d%d%d");
  ms.Target (buf);  // set its address
  char result = ms.Match(mch);
  if (result > 0)
  {
    // Выбираем результат
    for (int j = ms.MatchStart; j < ms.MatchStart+ms.MatchLength; j++)
    {
      chardec[i]=buf[j]; i++;
    }
    i=atoi(chardec);
  }
  return i;
}

// ****************************************************************************
// *          Выбрать данные из SIM900, в случае неудачи вернуть false        *
// ****************************************************************************
bool Talk_SIM900(uint32_t ncikl)
{
  bool isSend=true; 
  // Получаем состояние батареи
  if (AT_com(AT_CBC)!=0) isSend=false; 
  else
  {
    // Выбираем первые 4 цифры в ответе
    lipo=getIntByMatch(response,"%d%d%d%d");
    //Serial.print(F("lipo= ")); Serial.println(lipo); 

    // Проверяем уровень сигнала, первое значение это уровень сигнала в дБ,
    // он должен быть выше 5. Чем выше, тем лучше, до 31.
    if (AT_com(AT_CSQ)!=0) isSend=false;
    else
    {
      // Выбираем первые одну или более цифры в ответе
      dB=getIntByMatch(response,"%d(%d*)");
      //Serial.print(F("dB= ")); Serial.println(dB); 

      /*
      Serial.print(F("*** AT_CSQ:")); Serial.print(response); Serial.println(F("***")); 

      // Ищем позицию уровня сигнал
      int nb,ne;
      char *needle = "+CSQ: ";
      char *result = strstr(response, needle);
      if (result != NULL) 
      {
        Serial.print(F("*** result:")); Serial.print(result); Serial.println(F("***")); 
      }
      else 
      {
        Serial.println(F("Substring not found"));
      }
      */

      // При ненулевых данных формируем сообщение об уровне сигнала и батареи 
      //if ((lipo>0)&&(dB>0)) 
      //{
        //DbAndVoltToChar(lipo,dB,vi,chardec);
        //Serial.println(simMess); 
      //}
      //else isSend=false; 
    } 
  }
  return isSend; 
}

/*
Поиск в массиве char с помощью функций C
Для работы с массивами символов, заканчивающимися нулём, можно использовать стандартные функции C, например:
strchr — ищет символ в строке и возвращает указатель на него. Если символ не найден, возвращается нулевой указатель.
strstr — ищет подстроку в строке и возвращает указатель на её начало. Если подстрока не найдена, возвращается нулевой указатель.
 
alexgyver.ru
Пример использования strchr:
char buf = "hello world";
char* p = strchr(buf, 'w'); // p == "world", (p - buf) == 6
``` [20]

Также можно реализовать поиск вручную с помощью цикла, сравнивая каждый символ массива с искомым. Пример функции:
```cpp
int search_and_destroy(char* buff, size_t len, char c) {
  for (int i = 0; i < len; i++) {
    if (buff[i] == c) {
      return i;
    }
  }
  return -1;
}

*/

#endif

// *************************************************************** SIM900.h ***

